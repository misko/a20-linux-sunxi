## drivers/net/wireless/rtl8723au_bt/Kconfig
```kconfig
config RTL8723AU_BT
	tristate "Realtek 8723A USB Bluetooth"
	depends on USB
	select BT
	select BT_HCIBTUSB	
	---help---
	  Help message of RTL8723AU_BT
```

## drivers/staging/iio/magnetometer/Kconfig
```kconfig
#
# Magnetometer sensors
#
menu "Magnetometer sensors"

config SENSORS_AK8975
	tristate "Asahi Kasei AK8975 3-Axis Magnetometer"
	depends on I2C
	depends on GENERIC_GPIO
	help
	  Say yes here to build support for Asahi Kasei AK8975 3-Axis
	  Magnetometer.

	  To compile this driver as a module, choose M here: the module
	  will be called ak8975.

config SENSORS_BMA2X2
	tristate "BMA2x2 acceleration sensor support"
	depends on I2C && SENSORS
	help
	  If you say yes here, you get support for Bosch Sensortec's
	  acceleration sensors BMA255/BMA254/BMA355/BMA250E/BMA222E/BMA280.

config SENSORS_BMA2X2_ENABLE_INT1
	tristate "BMA2X2 acceleration sensor interrupt INT1 support"
	depends on SENSORS_BMA2X2
	help
	 If you say yes here, you get INT1 support for Bosch Sensortec
	 acceleration sensors BMA255/BMA254/BMA355/BMA250E/BMA222E/BMA280.
	 Select it will disable interrupt INT2 support

config SENSORS_BMA2X2_ENABLE_INT2
	tristate "BMA2X2 acceleration sensor interrupt INT2 support"
	depends on SENSORS_BMA2X2 && !SENSORS_BMA2X2_ENABLE_INT1
	help
	 If you say yes here, you get INT2 support for Bosch Sensortec
	 acceleration sensors BMA255/BMA254/BMA355/BMA250E/BMA222E/BMA280.
	 Can only open if you do NOT open interrupt INT1 support

config SENSORS_HMC5843
	tristate "Honeywell HMC5843 3-Axis Magnetometer"
	depends on I2C
	help
	  Say Y here to add support for the Honeywell HMC 5843 3-Axis
	  Magnetometer (digital compass).

	  To compile this driver as a module, choose M here: the module
	  will be called hmc5843

endmenu
```
